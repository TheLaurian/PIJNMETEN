/**
 * @cliArgs --board "/ti/boards/CC3220S_LAUNCHXL" --product "simplelink_cc32xx_sdk@5.10.00.02"
 * @versions {"data":"2021031521","timestamp":"2021031521","tool":"1.8.0+1863","templates":null}
 */

/**
 * Import the modules used in this configuration.
 */
const GPIO  = scripting.addModule("/ti/drivers/GPIO");
const GPIO1 = GPIO.addInstance();
const GPIO2 = GPIO.addInstance();
const GPIO3 = GPIO.addInstance();
const I2C   = scripting.addModule("/ti/drivers/I2C", {}, false);
const I2C1  = I2C.addInstance();
const RTOS  = scripting.addModule("/ti/drivers/RTOS");
const SPI   = scripting.addModule("/ti/drivers/SPI");
const SPI1  = SPI.addInstance();
const UART  = scripting.addModule("/ti/drivers/UART", {}, false);
const UART1 = UART.addInstance();

/**
 * Write custom configuration values to the imported modules.
 */
GPIO1.$hardware = system.deviceData.board.components.LED_RED;
GPIO1.$name     = "CONFIG_GPIO_LED_D10";

GPIO2.$name = "RSTN";
GPIO2.mode  = "Output";

GPIO3.$name = "MFIO";
GPIO3.mode  = "Output";

I2C1.$hardware  = system.deviceData.board.components.LP_I2C;
I2C1.$name      = "CONFIG_I2C";
I2C1.maxBitRate = 100;

const Power          = scripting.addModule("/ti/drivers/Power", {}, false);
Power.parkPins.$name = "ti_drivers_power_PowerCC32XXPins0";

SPI.includeNWP = false;

SPI1.$name       = "CONFIG_SPI_0";
SPI1.mode        = "Four Pin SS Active Low";
SPI1.spi.$assign = "SPI0";

UART1.$name     = "CONFIG_UART_0";
UART1.$hardware = system.deviceData.board.components.XDS110UART;

/**
 * Pinmux solution for unlocked pins/peripherals. This ensures that minor changes to the automatic solver in a future
 * version of the tool will not impact the pinmux you originally saw.  These lines can be completely deleted in order to
 * re-solve from scratch.
 */
GPIO1.gpioPin.$suggestSolution         = "boosterpack.29";
GPIO2.gpioPin.$suggestSolution         = "boosterpack.4";
GPIO3.gpioPin.$suggestSolution         = "boosterpack.18";
I2C1.i2c.$suggestSolution              = "I2C0";
I2C1.i2c.sdaPin.$suggestSolution       = "boosterpack.10";
I2C1.i2c.sclPin.$suggestSolution       = "boosterpack.9";
SPI1.spi.sclkPin.$suggestSolution      = "boosterpack.7";
SPI1.spi.misoPin.$suggestSolution      = "boosterpack.14";
SPI1.spi.mosiPin.$suggestSolution      = "boosterpack.15";
SPI1.spi.dmaRxChannel.$suggestSolution = "UDMA_CH30";
SPI1.spi.dmaTxChannel.$suggestSolution = "UDMA_CH31";
SPI1.spi.ssPin.$suggestSolution        = "boosterpack.30";
UART1.uart.$suggestSolution            = "UART0";
UART1.uart.txPin.$suggestSolution      = "55";
UART1.uart.rxPin.$suggestSolution      = "57";
